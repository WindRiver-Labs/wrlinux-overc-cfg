## conf/layer.conf
```bitbake
#
# Copyright (C) 2018 Wind River Systems, Inc.
#
# We have a conf and classes directory, add to BBPATH
BBPATH .= ":${LAYERDIR}"

BBFILE_COLLECTIONS += "wrlinux-overc-cfg"
BBFILE_PATTERN_wrlinux-overc-cfg = ""
BBFILE_PATTERN_IGNORE_EMPTY_wrlinux-overc-cfg = "1"

# This should only be incremented on significant changes that will
# cause compatibility issues with other layers
LAYERVERSION_wrlinux-overc-cfg = "1"
LAYERSERIES_COMPAT_wrlinux-overc-cfg = "thud wrl warrior zeus"
```
